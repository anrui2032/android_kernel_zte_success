## drivers/media/platform/msm/camera_v2/sensor/zte_eeprom/Kconfig
```kconfig
config OV16B10_031_EEPROM
	bool "ZTE OV16B10_031 Calibration support"
	depends on MSMB_CAMERA
	help
	  Enable support for ROM Interface for Calibration
	  Provides interface for reading the Claibration data.
	  and also provides support for writing data in case of FLASH ROM.
	  Currently supports CCI protocol

config S5K4H7_127_EEPROM
	bool "ZTE S5K4H7_127 Calibration support"
	depends on MSMB_CAMERA
	help
	  Enable support for ROM Interface for Calibration
	  Provides interface for reading the Claibration data.
	  and also provides support for writing data in case of FLASH ROM.
	  Currently supports CCI protocol
```

## drivers/platform/zte/Kconfig
```kconfig
# ZTE configuration options

config BOARD_ZTE
	bool "ZTE device"
	depends on ARCH_MSM
	help
	  Support for ZTE products

config BOARD_ZTE_SDM450
	bool "ZTE SDM450"
	depends on ARCH_SDM450
	select BOARD_ZTE
	help
	  Support for SDM450-based ZTE variants

menu "ZTE board selection"

config BOARD_ZTE_SUCCESS
	bool "SUCCESS board"
	select BOARD_ZTE_SDM450
	help
	  Support for ZTE Blade V9

endmenu
```
